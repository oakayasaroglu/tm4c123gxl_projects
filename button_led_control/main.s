GPIO_PORTE_DATA_R  EQU 0x400243FC
GPIO_PORTE_DIR_R   EQU 0x40024400
GPIO_PORTE_DEN_R   EQU 0x4002451C
SYSCTL_RCGCGPIO_R  EQU 0x400FE608

GPIO_PE0           EQU 0x40024004 ; SW1 INPUT'S POINTER
GPIO_PE1           EQU 0x40024008 ; SW2 INPUT'S POINTER
GPIO_PE2           EQU 0x40024010 ; SW3 INPUT'S POINTER
GPIO_PE3           EQU 0x40024020 ; LED OUTPUT'S POINTER

      THUMB
      AREA    DATA, ALIGN=2

      ALIGN
      AREA    |.text|, CODE, READONLY, ALIGN=2
      EXPORT  Start

GPIO_Init

      LDR R1, =SYSCTL_RCGCGPIO_R; SELECT CLOCK SETTING'S REGISTER
      LDR R0, [R1]                   
      ORR R0, R0, #0x10 ; ENABLE CLOCK FOR PORT E 0x10=#00010000-->XXFEDCBA
      STR R0, [R1] ; STORE TO ADRESS
      NOP ; GIVE 
      NOP ; SOME 
      NOP ; TIME
      NOP ; TO MCU
	  
      LDR R1, =GPIO_PORTE_DIR_R ; SELECT I or O -DIRECTION REGISTER- FOR PORT E
      LDR R0, [R1]                 
      ORR R0, R0, #0x8 ; 1 , 0 , 0 , 0 ---> PE3=OUTPUT , PE2=INPUT , PE1=INPUT , PE0=INPUT
      STR R0, [R1] ; STORE TO ADRESS

      LDR R1, =GPIO_PORTE_DEN_R ; SELECT DIGITAL ENABLER REGISTER FOR PORT E
      LDR R0, [R1]                
      ORR R0, R0, #0xF ; 1 , 1 , 1 , 1 ---> PE3=DIGITAL ENABLE , PE2=DIGITAL ENABLE , PE1=DIGITAL ENABLE , PE0=DIGITAL ENABLE , 
      STR R0, [R1] ; STORE TO ADRESS  
	  
      BX  LR ; FINISH GPIO_Init
 
Start 
      BL  GPIO_Init ; CALL GPIO INIT
      LDR R5,=GPIO_PE3 ; LOAD PE3'S ADRESS TO R5
      LDR R6,=GPIO_PE0 ; LOAD PE0'S ADRESS TO R6
      LDR R7,=GPIO_PE1 ; LOAD PE1'S ADRESS TO R7
      LDR R8,=GPIO_PE2 ; LOAD PE2'S ADRESS TO R8
	
loop ; ENDLESS LOOP
      LDR R0,[R6] ; SELECT PE0
      LDR R1,[R7] ; SELECT PE1 TOO
      MOV R1,R1,LSR #1 ; AND SHIFT 1 BIT RIGHT BECAUSE WE CAN EXECUTE LOGICAL OPERATIONS TRULY IF THEY ARE ON THE SAME DIGIT
	  LDR R2,[R8] ; SELECT PE2
      MOV R2,R2,LSR #2 ; AND SHIFT 2 BITS RIGHT 
      EOR R3,R0,R1 ; R3 = R0 XOR R1
      EOR R3,R3,R2 ; R3 = R3 XOR R2
      EOR R3,R3,#1 ; R3 = R3 XOR 1 ---> WE EXECUTED THIS OPERATION BECAUSE OUR MAIN PURPOSE WAS EXECUTE "R3 = R3 XNOR R2" 
      MOV R3,R3,LSL #3 ; SHIFT 3 BITS LEFT BECAUSE WE'LL SEND OUTPUT VALUE FOR PE3
      STR R3,[R5] ; STORE THE VALUE TO PE3
      B   loop ; RETURN TO LOOP

      ALIGN        
      END          
          
